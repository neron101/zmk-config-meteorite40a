## config/west.yml
```yaml
manifest:
  remotes:
    - name: zmkfirmware
      url-base: https://github.com/zmkfirmware
    - name: cormoran
      url-base: https://github.com/cormoran
    - name: iwk7273
      url-base: https://github.com/iwk7273
  projects:
    # ZMK本体（DYA Studio対応のcormoran版 / v0.3ベース）
    - name: zmk
      remote: cormoran
      revision: v0.3-branch+dya
      import: app/west.yml
    # meteorite40用モジュール（ZMK v0.3互換の版に固定）
    - name: zmk-pmw3610-driver
      remote: iwk7273
      revision: 72280acc8e4467ed1b4947ee216c6bf31d0278b2
    - name: zmk-feature-sensor_rotation
      remote: iwk7273
      revision: e1a0186220ade99220d04dadf9735b758cfdf086
    - name: zmk-feature-xy_clipper
      remote: iwk7273
      revision: 643c1cabb9636de3d13e518c91c4350def1c1bb0
    - name: zmk-feature-scaling
      remote: iwk7273
      revision: 5c7402e3e9a675376cc0c32719f9fc98501afd12
    # DYA Studio用モジュール
    - name: zmk-module-ble-management
      remote: cormoran
      revision: zmk-v0.3.0.0
    - name: zmk-module-battery-history
      remote: cormoran
      revision: main
    - name: zmk-module-settings-rpc
      remote: cormoran
      revision: main
    - name: zmk-module-runtime-input-processor
      remote: cormoran
      revision: zmk-v0.3.0.0
    - name: zmk-behavior-runtime-sensor-rotate
      remote: cormoran
      revision: main
  self:
    path: config
```
